## sdkconfig.defaults
```kconfig
# the following two lines remove unnecessary blob of debug messages sent to UART0 during boot
CONFIG_BOOTLOADER_LOG_LEVEL_WARN=y
CONFIG_LOG_DEFAULT_LEVEL_WARN=y
CONFIG_LOG_COLORS=n

# comment out for default of 160MHz and less power consumption
CONFIG_ESP_DEFAULT_CPU_FREQ_MHZ_240=y
CONFIG_ESPTOOLPY_FLASHSIZE_8MB=y

# must be enabled if web-ui is used
CONFIG_HTTPD_WS_SUPPORT=y
# some browsers send too much stuff in headers
CONFIG_HTTPD_MAX_REQ_HDR_LEN=2048
# the default of 10 sockets may not be enough for http server to handle incoming http/ws connections
CONFIG_LWIP_MAX_SOCKETS=16

# this must be enabled if we want OTA to function over plain HTTP
CONFIG_ESP_HTTPS_OTA_ALLOW_HTTP=y
# use custom partition table with 2 OTA partitions
CONFIG_PARTITION_TABLE_CUSTOM=y

# this is needed if debug/tasks module is used
# CONFIG_FREERTOS_USE_TRACE_FACILITY=y

# the below 2 lines were copied from esp32-arduino, may not be necessary
CONFIG_ESP_WIFI_STATIC_RX_BUFFER_NUM=16
CONFIG_ESP_WIFI_RX_BA_WIN=16

CONFIG_IDF_TARGET="esp32s3"

CONFIG_LWIP_IP_FORWARD=y
CONFIG_LWIP_IPV4_NAPT=y

CONFIG_ESP32M_LOG_LEVEL_VERBOSE=y
CONFIG_ESP32M_LOG_HOOK_ESPIDF=n
CONFIG_ESP32M_FS_ROOT_LITTLEFS=y
CONFIG_ESP32M_UI_BUILD_ONCE=y


CONFIG_HEAP_POISONING_COMPREHENSIVE=y
CONFIG_HEAP_ABORT_WHEN_ALLOCATION_FAILS=y
CONFIG_COMPILER_STACK_CHECK_MODE_ALL=y
```
